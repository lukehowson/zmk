/*
 * Copyright (c) 2020 Pete Johanson
 *
 * SPDX-License-Identifier: MIT
 */

/* No key matrix required for dongle. Use dummy values if necessary. */

/ {
    kscan0: kscan {
        compatible = "zmk";
    };
};
